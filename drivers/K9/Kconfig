## drivers/K9/Kconfig
```kconfig
config K9
    tristate "K9 driver"
    default m
    help
      K9 loadable kernel module.
```

## drivers/mydriver/Kconfig
```kconfig
config MYDRIVER
    tristate "A70Q MyDriver"
    default m
    help
      Test loadable kernel module for the A70Q kernel.
```
